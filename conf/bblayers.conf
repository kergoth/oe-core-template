## conf/bblayers.conf
```bitbake
TOPDIR := '${@os.path.dirname(os.path.dirname(FILE))}'
BBPATH = '${TOPDIR}:${HOME}/.oe'
BBFILES = ''
BBLAYERS = '\
    ${TOPDIR}/meta-mentor/meta-mel \
    ${TOPDIR}/meta-mentor/meta-mel-support \
    ${TOPDIR}/meta-mentor/meta-mentor-staging \
    ${TOPDIR}/poky/meta-yocto-bsp \
    ${TOPDIR}/poky/meta-yocto \
    ${TOPDIR}/poky/meta \
    ${TOPDIR}/meta-oe/meta-oe \
'
#BBLAYERS =+ '${TOPDIR}/meta-sourcery'

LCONF_VERSION = "6"
```

## conf/local.conf
```bitbake
MACHINE ?= "qemux86"
DISTRO ?= "mel"
TMPDIR = "${TOPDIR}/build"
TCLIBCAPPEND = ""
MACHINE_KERNEL_PR ??= "0"

EXTRA_IMAGE_FEATURES += "debug-tweaks"
USER_CLASSES ?= "buildstats buildstats-summary"
INHERIT += "buildhistory"
PATCHRESOLVE = "noop"
BB_DISKMON_DIRS = "\
    STOPTASKS,${TMPDIR},1G,100K \
    STOPTASKS,${DL_DIR},1G,100K \
    STOPTASKS,${SSTATE_DIR},1G,100K \
    ABORT,${TMPDIR},100M,1K \
    ABORT,${DL_DIR},100M,1K \
    ABORT,${SSTATE_DIR},100M,1K \
"

HOSTNAME := "${@os.uname()[1]}"
include conf/local/${HOSTNAME}.conf

CONF_VERSION = '1'
```
